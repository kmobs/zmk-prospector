## boards/shields/prospector_adapter/src/layouts/operator/Kconfig.defconfig
```kconfig
if PROSPECTOR_STATUS_SCREEN_OPERATOR

config ZMK_DISPLAY_STATUS_SCREEN_CUSTOM
    select LV_USE_LABEL
    select LV_USE_FLEX
    select LV_USE_ARC
    select LV_USE_BAR
    select LV_COLOR_SCREEN_TRANSP

config ZMK_WPM
    default y

config LV_Z_MEM_POOL_SIZE
    default 20000

config PROSPECTOR_ESB_MODE
    bool "ESB Mode - Disable battery and connection status display"
    default n
    help
      Enable this option when using ESB (Enhanced ShockBurst) communication protocol.
      ESB does not pass battery status from peripherals, so this disables the
      battery circles and USB/BLE output status widgets, providing more space
      for other display elements.

endif
```
